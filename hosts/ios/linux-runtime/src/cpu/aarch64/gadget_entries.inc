// Static micro-operation manifest. Intentionally included more than once.
// The decoder, assembly bodies and entry table share this exact order.
GADGET_BASIC(noop)
GADGET_BASIC(move32)
GADGET_BASIC(move64)
GADGET_BASIC(keep32)
GADGET_BASIC(keep64)
GADGET_BASIC(select32)
GADGET_BASIC(select64)
GADGET_BASIC(load1)
GADGET_BASIC(load2)
GADGET_BASIC(load4)
GADGET_BASIC(load8)
GADGET_BASIC(store1)
GADGET_BASIC(store2)
GADGET_BASIC(store4)
GADGET_BASIC(store8)
GADGET_BASIC(pair_load4)
GADGET_BASIC(pair_load8)
GADGET_BASIC(pair_store4)
GADGET_BASIC(pair_store8)
GADGET_BASIC(conditional)
GADGET_BASIC(compare_branch32)
GADGET_BASIC(compare_branch64)
GADGET_BASIC(test_branch)
GADGET_BASIC(copy32)
GADGET_BASIC(copy64)
GADGET_BINARY(add_reg32, add, w8, w10, 0, 0, 0)
GADGET_BINARY(adds_reg32, adds, w8, w10, 0, 1, 0)
GADGET_BINARY(sub_reg32, sub, w8, w10, 0, 0, 0)
GADGET_BINARY(subs_reg32, subs, w8, w10, 0, 1, 0)
GADGET_BINARY(add_imm32, add, w8, w10, 1, 0, 0)
GADGET_BINARY(adds_imm32, adds, w8, w10, 1, 1, 0)
GADGET_BINARY(sub_imm32, sub, w8, w10, 1, 0, 0)
GADGET_BINARY(subs_imm32, subs, w8, w10, 1, 1, 0)
GADGET_BINARY(and_reg32, and, w8, w10, 0, 0, 0)
GADGET_BINARY(orr_reg32, orr, w8, w10, 0, 0, 0)
GADGET_BINARY(eor_reg32, eor, w8, w10, 0, 0, 0)
GADGET_BINARY(ands_reg32, ands, w8, w10, 0, 1, 0)
GADGET_BINARY(and_inv32, and, w8, w10, 0, 0, 1)
GADGET_BINARY(orr_inv32, orr, w8, w10, 0, 0, 1)
GADGET_BINARY(eor_inv32, eor, w8, w10, 0, 0, 1)
GADGET_BINARY(ands_inv32, ands, w8, w10, 0, 1, 1)
GADGET_BINARY(and_imm32, and, w8, w10, 1, 0, 0)
GADGET_BINARY(orr_imm32, orr, w8, w10, 1, 0, 0)
GADGET_BINARY(eor_imm32, eor, w8, w10, 1, 0, 0)
GADGET_BINARY(ands_imm32, ands, w8, w10, 1, 1, 0)
GADGET_CARRY(adc32, adc, w8, w10, 0)
GADGET_CARRY(adcs32, adcs, w8, w10, 1)
GADGET_CARRY(sbc32, sbc, w8, w10, 0)
GADGET_CARRY(sbcs32, sbcs, w8, w10, 1)
GADGET_PRODUCT(mul32, mul, w8, w10, w11, 0)
GADGET_PRODUCT(mneg32, mneg, w8, w10, w11, 0)
GADGET_PRODUCT(madd32, madd, w8, w10, w11, 1)
GADGET_PRODUCT(msub32, msub, w8, w10, w11, 1)
GADGET_BINARY(add_reg64, add, x8, x10, 0, 0, 0)
GADGET_BINARY(adds_reg64, adds, x8, x10, 0, 1, 0)
GADGET_BINARY(sub_reg64, sub, x8, x10, 0, 0, 0)
GADGET_BINARY(subs_reg64, subs, x8, x10, 0, 1, 0)
GADGET_BINARY(add_imm64, add, x8, x10, 1, 0, 0)
GADGET_BINARY(adds_imm64, adds, x8, x10, 1, 1, 0)
GADGET_BINARY(sub_imm64, sub, x8, x10, 1, 0, 0)
GADGET_BINARY(subs_imm64, subs, x8, x10, 1, 1, 0)
GADGET_BINARY(and_reg64, and, x8, x10, 0, 0, 0)
GADGET_BINARY(orr_reg64, orr, x8, x10, 0, 0, 0)
GADGET_BINARY(eor_reg64, eor, x8, x10, 0, 0, 0)
GADGET_BINARY(ands_reg64, ands, x8, x10, 0, 1, 0)
GADGET_BINARY(and_inv64, and, x8, x10, 0, 0, 1)
GADGET_BINARY(orr_inv64, orr, x8, x10, 0, 0, 1)
GADGET_BINARY(eor_inv64, eor, x8, x10, 0, 0, 1)
GADGET_BINARY(ands_inv64, ands, x8, x10, 0, 1, 1)
GADGET_BINARY(and_imm64, and, x8, x10, 1, 0, 0)
GADGET_BINARY(orr_imm64, orr, x8, x10, 1, 0, 0)
GADGET_BINARY(eor_imm64, eor, x8, x10, 1, 0, 0)
GADGET_BINARY(ands_imm64, ands, x8, x10, 1, 1, 0)
GADGET_CARRY(adc64, adc, x8, x10, 0)
GADGET_CARRY(adcs64, adcs, x8, x10, 1)
GADGET_CARRY(sbc64, sbc, x8, x10, 0)
GADGET_CARRY(sbcs64, sbcs, x8, x10, 1)
GADGET_PRODUCT(mul64, mul, x8, x10, x11, 0)
GADGET_PRODUCT(mneg64, mneg, x8, x10, x11, 0)
GADGET_PRODUCT(madd64, madd, x8, x10, x11, 1)
GADGET_PRODUCT(msub64, msub, x8, x10, x11, 1)
// Hot fixed-offset 64-bit memory operations require no address-mode decoding.
GADGET_MEMORY(load8_offset, 8, 0, 0)
GADGET_MEMORY(store8_offset, 8, 1, 0)
GADGET_MEMORY(pair_load8_offset, 16, 0, 1)
GADGET_MEMORY(pair_store8_offset, 16, 1, 1)
